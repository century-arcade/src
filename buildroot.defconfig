## buildroot.defconfig
```kconfig
BR2_DEFCONFIG="$(CONFIG_DIR)/defconfig"
BR2_DL_DIR="$(ARCADE)/downloads"
BR2_HOST_DIR="$(ARCADE)/host"
BR2_ENABLE_DEBUG=y
BR2_PREFER_STATIC_LIB=y
BR2_GLOBAL_PATCH_DIR="$(ARCADE)/src/buildroot-patches/"
BR2_KERNEL_HEADERS_3_10=y
BR2_UCLIBC_CONFIG="$(ARCADE)/src/uclibc.config"
BR2_TOOLCHAIN_BUILDROOT_LARGEFILE=y
BR2_TOOLCHAIN_BUILDROOT_WCHAR=y
BR2_PTHREADS=y
BR2_BINUTILS_VERSION_2_23_2=y
BR2_TOOLCHAIN_BUILDROOT_CXX=y
BR2_PACKAGE_ALSA_UTILS=y
BR2_PACKAGE_ALSA_UTILS_ALSACONF=y
BR2_PACKAGE_ALSA_UTILS_AMIXER=y
BR2_PACKAGE_ALSA_UTILS_APLAY=y
BR2_PACKAGE_ALSA_UTILS_SPEAKER_TEST=y
BR2_PACKAGE_AUMIX=y
BR2_PACKAGE_HOST_GDB=y
BR2_PACKAGE_STRACE=y
BR2_INIT_NONE=y
# BR2_TARGET_GENERIC_REMOUNT_ROOTFS_RW is not set
# BR2_PACKAGE_BUSYBOX is not set
BR2_PACKAGE_SDL=y
BR2_PACKAGE_SDL_IMAGE=y
# BR2_PACKAGE_SDL_IMAGE_BMP is not set
BR2_PACKAGE_SDL_IMAGE_PNG=y
BR2_PACKAGE_SDL_MIXER=y
BR2_PACKAGE_SDL_SOUND=y
BR2_PACKAGE_SDL_SOUND_PLAYSOUND=y
BR2_PACKAGE_JPEG=y
BR2_PACKAGE_NCURSES=y
BR2_TARGET_SYSLINUX=y
# BR2_TARGET_SYSLINUX_PXELINUX is not set
```
